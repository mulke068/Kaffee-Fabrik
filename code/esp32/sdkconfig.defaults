## code/esp32/sdkconfig.defaults
```kconfig
# Enable FreeRTOS trace/debugging for task stats
CONFIG_FREERTOS_USE_TRACE_FACILITY=y
CONFIG_FREERTOS_GENERATE_RUN_TIME_STATS=y
CONFIG_FREERTOS_USE_STATS_FORMATTING_FUNCTIONS=y
CONFIG_FREERTOS_VTASKLIST_INCLUDE_COREID=y
CONFIG_FREERTOS_TASK_FUNCTION_WRAPPER=y

# ESP Task watchdog
CONFIG_ESP_TASK_WDT_EN=y

# Required for Arduino as component
CONFIG_FREERTOS_HZ=1000
CONFIG_ARDUINO_RUN_CORE1=y
CONFIG_ARDUINO_EVENT_RUN_CORE1=y
```
